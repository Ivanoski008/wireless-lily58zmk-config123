## config/kconfig.defconfig
```kconfig
if SHIELD_LILY58

config ZMK_KEYBOARD_NAME
default "lily58'

CONFIG_ZMK_DISPLAY=y
CONFIG_ZMK_RGB_UNDERGLOW=y
CONFIG_ZMK_WIDGET_WPM_STATUS=y
CONFIG_ZMK_DISPLAY_STATUS_SCREEN_BUILT_IN=y
CONFIG_ZMK_DISPLAY_WORK_QUEUE_SYSTEM=y

endif
```

## config/kconfig.shield
```kconfig
config SHIELD_LILY58
 def_bool $(shields-list-contains, lily58_left, lily58_right)
```
